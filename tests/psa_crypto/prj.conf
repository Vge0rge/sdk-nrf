## prj.conf
```kconfig
#
# Copyright (c) 2021-2024 Nordic Semiconductor ASA
#
# SPDX-License-Identifier: LicenseRef-Nordic-5-Clause
#

CONFIG_ZTEST=y
CONFIG_ZTEST_STACK_SIZE=15360

CONFIG_SYS_CLOCK_TICKS_PER_SEC=1000
CONFIG_MAIN_STACK_SIZE=8192
CONFIG_HEAP_MEM_POOL_SIZE=8192

# Enable logging
CONFIG_CONSOLE=y

# Enable nRF Security backend for PSA Crypto API
CONFIG_NRF_SECURITY=y
CONFIG_MBEDTLS_PSA_CRYPTO_C=y
CONFIG_PSA_CRYPTO_DRIVER_CRACEN=y
CONFIG_PSA_CRYPTO_DRIVER_CC3XX=y

CONFIG_HW_UNIQUE_KEY=y
CONFIG_HW_UNIQUE_KEY_WRITE_ON_CRYPTO_INIT=y

CONFIG_MBEDTLS_ENABLE_HEAP=y
CONFIG_MBEDTLS_HEAP_SIZE=8192

# Enable cryptographic features
CONFIG_PSA_WANT_ECC_TWISTED_EDWARDS_255=y
CONFIG_PSA_WANT_KEY_TYPE_ECC_KEY_PAIR_EXPORT=y

CONFIG_PSA_WANT_ALG_ECDSA=y
CONFIG_PSA_WANT_KEY_TYPE_ECC_KEY_PAIR_IMPORT=y
CONFIG_PSA_WANT_ECC_SECP_R1_256=y
CONFIG_PSA_WANT_ALG_SHA_256=y
CONFIG_PSA_WANT_ALG_SHA_512=y
CONFIG_PSA_WANT_KEY_TYPE_AES=y
CONFIG_PSA_WANT_ALG_PURE_EDDSA=y

CONFIG_PSA_WANT_KEY_TYPE_ECC_KEY_PAIR_GENERATE=y
CONFIG_PSA_WANT_GENERATE_RANDOM=y

CONFIG_TFM_CMAKE_BUILD_TYPE_DEBUG=y
CONFIG_TFM_PARTITION_INITIAL_ATTESTATION=y
CONFIG_TFM_DUMMY_PROVISIONING=y
```

## src/psa_tests_common.c
```c
/*
 * Copyright (c) 2024 Nordic Semiconductor ASA
 *
 * SPDX-License-Identifier: LicenseRef-Nordic-5-Clause
 */

#include <stdarg.h>
#include <string.h>
#include <stdint.h>
#include <stddef.h>
#include <zephyr/sys/printk.h>

#include <psa/crypto.h>
#include <psa/crypto_values.h>
#include <psa/crypto_extra.h>

#include <zephyr/sys/util.h>
#include <zephyr/sys_clock.h>
#include <zephyr/logging/log.h>
#include <zephyr/ztest.h>
#include <pm_config.h>
#include "psa_tests_common.h"
#include <hw_unique_key.h>

#ifdef CONFIG_BUILD_WITH_TFM
#include <tfm_ns_interface.h>
#include <tfm_builtin_key_ids.h>

#if defined(NRF54L15_XXAA)
#include "cracen_psa_kmu.h"
#endif

#include <tfm_crypto_defs.h>
#else
#include <cracen_psa.h>
#endif

LOG_MODULE_REGISTER(ikg, LOG_LEVEL_INF);

ZTEST_SUITE(test_suite_ikg, NULL, NULL, NULL, NULL, NULL);

static psa_key_id_t key_id;

int crypto_init(void)
{
	psa_status_t status;

#if !defined(CONFIG_BUILD_WITH_TFM)
	if (!hw_unique_key_are_any_written()) {
		status = hw_unique_key_write_random();
		if (status != HW_UNIQUE_KEY_SUCCESS) {
			return status;
		}
	}
#endif
	status = psa_crypto_init();
	if (status != PSA_SUCCESS) {
		return status;
	}
	return APP_SUCCESS;
}

int crypto_finish(void)
{
	psa_status_t status;

	status = psa_destroy_key(key_id);
	if (status != PSA_SUCCESS) {
		return status;
	}

	return APP_SUCCESS;
}
```
