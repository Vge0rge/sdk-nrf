## modules/mcuboot/Kconfig
```kconfig
menu "MCUboot"

if BOOTLOADER_MCUBOOT

# The name of this configuration needs to match the requirements set by the
# script `partition_manager.py`. See `pm.yml` in the application directory
# of MCUBoot.
module=MCUBOOT
source "${ZEPHYR_BASE}/../nrf/subsys/partition_manager/Kconfig.template.build_strategy"

config MCUBOOT_IMAGE_VERSION
	string "Image version"
	default "0.0.0+0"
	help
	  Value to be passed as 'version' argument to 'imgtool.py' when
	  creating signed image. Note that no semantics are connected to
	  this variable. It does not provide downgrade prevention, and is only
	  valuable for debugging purposes. Format: maj.min.rev+build with
	  latter parts optional.

config PM_PARTITION_SIZE_MCUBOOT_PROVISION
	hex
	default 0x280 if SOC_NRF9160 || SOC_NRF5340_CPUAPP # Stored in OTP region
	default FPROTECT_BLOCK_SIZE
	prompt "Flash space reserved for PROVISION" if !(SOC_NRF9160 || SOC_NRF5340_CPUAPP)
	help
	  Flash space set aside for the PROVISION partition.

config MCUBOOT_HW_COUNTER_SLOTS
	int "Number of monotonic counter slots used for each MCUBOOT hardware security counters."
	default 240
	range 1 300 if SOC_NRF5340_CPUAPP || SOC_NRF9160
	range 1 1800 if SOC_SERIES_NRF52X
	range 1 400 if SOC_SERIES_NRF51X
	help
	  The number of monotonic counter slots available for the counter,
	  i.e., the number of times the counter can be updated.
	  The slots are 16 bits each. The number of slots is rounded up to the nearest even
	  number to ensure that the total size of header and slots is aligned on a 32-bit word.
	  Rationale for the default number (240): Assume one update a month for
	  10 years, then double that value just in case. This default fits
	  comfortably within the "OTP" region of UICR.
	  Regarding ranges: The actual maximum depends on the number of
	  provisioned public keys, since they share the space. The same is true if
	  other data is stored in the "OTP" region (on for example nRF91 and nRF53).
	  This configuration should not be used in code. Instead, the header before the
	  slots should be read at run-time.

config MCUBOOT_SECURE_COUNTER_ADDRESS
	hex "The address of the secure counters used by mcuboot"
	help
	  The address of the secure counters should be placed on the OTP
	  region of the flash.

# HACK: NCS temphack to keep our imgtool integration working now that
# there is no CONFIG_DT_* CMake namespace anymore. Use Zephyr
# kconfigfunctions to thread the flash write block size through
# Kconfig so it can be accessed from CMake. Needs a better solution.
DT_ZEPHYR_FLASH := zephyr,flash
DT_CHOSEN_ZEPHYR_FLASH := $(dt_chosen_path,$(DT_ZEPHYR_FLASH))
config MCUBOOT_FLASH_WRITE_BLOCK_SIZE
	int
	default $(dt_node_int_prop_int,$(DT_CHOSEN_ZEPHYR_FLASH),write-block-size)

endif # BOOTLOADER_MCUBOOT

config DT_FLASH_WRITE_BLOCK_SIZE
	int
	default $(dt_node_int_prop_int,$(DT_CHOSEN_ZEPHYR_FLASH),write-block-size)

endmenu
```

## samples/crypto/aes_gcm/boards/nrf9160dk_nrf9160.conf
```kconfig
# Enable Oberon backend since GCM is not supported in
# hardware in nRF9160
CONFIG_PSA_CRYPTO_DRIVER_OBERON=y
CONFIG_PSA_CRYPTO_DRIVER_CC3XX=n
CONFIG_TFM_IPC=y
CONFIG_TFM_ISOLATION_LEVEL=2
```
